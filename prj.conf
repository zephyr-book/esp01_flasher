## CMakeLists.txt
```
cmake_minimum_required(VERSION 3.20.0)

# The board (zbook/rp2350b/m33) comes from the `zbook` Zephyr module declared in
# west.yml — no BOARD_ROOT here. Select it at build time with `-b zbook/rp2350b/m33`.
find_package(Zephyr REQUIRED HINTS $ENV{ZEPHYR_BASE})
project(bringup LANGUAGES C)

include_directories(./include)

file(GLOB_RECURSE SRC ${CMAKE_SOURCE_DIR} "src/*.c")
target_sources(app PRIVATE ${SRC})
```

## west.yml
```
manifest:
        remotes:
                - name: zephyrproject
                  url-base: https://github.com/zephyrproject-rtos
                - name: zephyr-book
                  url-base: https://github.com/zephyr-book
                - name: edgebr
                  url-base: https://github.com/edgebr

        projects:
                - name: zephyr
                  remote: zephyrproject
                  revision: v4.4.0
                  clone-depth: 1
                  # path-prefix below also prepends to this project's own path,
                  # so `path: zephyr` resolves to deps/zephyr.
                  path: zephyr
                  import:
                          path-prefix: deps/
                          name-allowlist:
                                  - hal_rpi_pico
                                  - cmsis_6
                                  - fatfs
                                  - littlefs

                # Board support shipped as a Zephyr module (provides boards/ via module.yml).
                - name: zbook
                  remote: zephyr-book
                  revision: main

                - name: oled-mono-fonts
                  remote: edgebr
                  revision: zephyr
                  path: deps/modules/fonts/oled-mono-fonts

                - name: oled-sh1106-zephyr
                  remote: edgebr
                  revision: 3-wire-spi
                  clone-depth: 1
                  path: deps/modules/drivers/display

        self:
                path: esp01_flasher
```

## prj.conf
```kconfig
# ESP-01 USB <-> uart1 flashing bridge.
#
# Build (no shield, no Wi-Fi -- uart1 must stay a plain UART):
#   west build -p always -b zbook/rp2350b/m33
# Then flash the RP2350 over SWD as usual (just flash / west flash).

# --- USB device stack (device_next) + CDC ACM serial class ---
CONFIG_USB_DEVICE_STACK_NEXT=y
CONFIG_USBD_CDC_ACM_CLASS=y
CONFIG_CDC_ACM_SERIAL_INITIALIZE_AT_BOOT=n

# --- Serial: interrupt-driven bridge on both ports, host line-coding readback,
#     and runtime reconfigure so uart1 can follow the host baud (esptool). ---
CONFIG_SERIAL=y
CONFIG_UART_INTERRUPT_DRIVEN=y
CONFIG_UART_LINE_CTRL=y
CONFIG_UART_USE_RUNTIME_CONFIGURE=y

# --- ESP power/reset control lines ---
CONFIG_GPIO=y

# --- Plumbing ---
CONFIG_RING_BUFFER=y
CONFIG_HWINFO=y

# Diagnostics on the console (uart0); the flasher has no interactive shell.
CONFIG_LOG=y
CONFIG_USBD_LOG_LEVEL_ERR=y
CONFIG_UDC_DRIVER_LOG_LEVEL_ERR=y
CONFIG_USBD_CDC_ACM_LOG_LEVEL_OFF=y

CONFIG_ASSERT=y
CONFIG_MAIN_STACK_SIZE=2048
```

## app.overlay
```dts
/*
 * Copyright (c) 2026 Centro de Inovacao EDGE
 * SPDX-License-Identifier: Apache-2.0
 *
 * ESP-01 (ESP8266) USB <-> UART flashing bridge.
 *
 * The ESP module hangs off uart1 (TX=GP20, RX=GP21), already described by the
 * board's common dtsi. Here we only add the USB side (CDC ACM over the RP2350
 * native USB device controller) and the ESP power/reset control lines that the
 * zbook_wifi shield's esp8266 node would normally own -- this app does NOT use
 * that shield, so uart1 stays a plain UART we can bridge byte-for-byte.
 */

#include <zephyr/dt-bindings/gpio/gpio.h>

/ {
	/*
	 * ESP-01 control lines, mirroring the zbook_wifi shield's esp8266 node:
	 *   power-gpios = GP19, active-high  (module power / enable)
	 *   reset-gpios = GP18, active-low   (driven from the host RTS line)
	 * GPIO0 (bootloader strap) is grounded by hand, so it is not described.
	 */
	esp01: esp01 {
		compatible = "edge,esp01-control";
		power-gpios = <&gpio0 19 GPIO_ACTIVE_HIGH>;
		reset-gpios = <&gpio0 18 GPIO_ACTIVE_LOW>;
	};
};

&usbd {
	status = "okay";

	cdc_acm_uart0: cdc_acm_uart0 {
		compatible = "zephyr,cdc-acm-uart";
		label = "ESP01 flashing bridge";
	};
};
```

## dts/bindings/edge,esp01-control.yaml
```yaml
# Copyright (c) 2026 Centro de Inovacao EDGE
# SPDX-License-Identifier: Apache-2.0

description: |
  ESP-01 (ESP8266) power and reset control lines for the USB-UART flashing
  bridge. Mirrors the power-gpios/reset-gpios of the zbook_wifi shield's
  esp8266 node, but without instantiating the ESP-AT driver so uart1 stays a
  plain UART that the bridge can drive directly.

compatible: "edge,esp01-control"

properties:
  power-gpios:
    type: phandle-array
    required: true
    description: Module power / enable line (active high).
  reset-gpios:
    type: phandle-array
    required: true
    description: Reset line (active low); driven from the host RTS line.
```

## src/main.c
```c
/**
 * @file main.c
 * @brief ESP-01 (ESP8266) USB <-> uart1 transparent flashing bridge.
 *
 * Bridges the RP2350 native USB CDC ACM port to uart1 (where the ESP-01 lives)
 * byte-for-byte, so a host tool such as esptool can talk to the ESP8266 ROM
 * bootloader straight over USB. Two features make it a usable flasher:
 *
 *   - Baud tracking: the host's CDC line coding is applied to uart1 at runtime,
 *     so esptool's high-speed flashing (e.g. --baud 460800) works.
 *   - Reset control: the host RTS line is mirrored onto the ESP reset (GP18),
 *     so esptool's `--before default_reset` resets the chip automatically. The
 *     GPIO0 bootloader strap is grounded by hand.
 *
 * @copyright Copyright (c) 2026 Centro de Inovacao EDGE
 * SPDX-License-Identifier: Apache-2.0
 */

#include "usbd_setup.h"

#include <zephyr/device.h>
#include <zephyr/drivers/gpio.h>
#include <zephyr/drivers/uart.h>
#include <zephyr/kernel.h>
#include <zephyr/logging/log.h>
#include <zephyr/sys/ring_buffer.h>
#include <zephyr/usb/usbd.h>

LOG_MODULE_REGISTER(esp01_flasher, LOG_LEVEL_INF);

/* One ring buffer per direction; sized for a few USB full-speed packets. */
#define BRIDGE_RING_SIZE 2048
/* Bytes moved per FIFO read/fill burst inside the ISR. */
#define BRIDGE_CHUNK     64

static const struct device *const cdc_dev = DEVICE_DT_GET_ONE(zephyr_cdc_acm_uart);
static const struct device *const esp_dev = DEVICE_DT_GET(DT_NODELABEL(uart1));

static const struct gpio_dt_spec esp_power = GPIO_DT_SPEC_GET(DT_NODELABEL(esp01), power_gpios);
static const struct gpio_dt_spec esp_reset = GPIO_DT_SPEC_GET(DT_NODELABEL(esp01), reset_gpios);

RING_BUF_DECLARE(rb_usb_to_esp, BRIDGE_RING_SIZE);
RING_BUF_DECLARE(rb_esp_to_usb, BRIDGE_RING_SIZE);

/**
 * @brief One side of the bridge.
 *
 * Bytes read from @ref dev are stored in @ref rx_ring; the @ref peer drains
 * that same ring through its TX path. So a port transmits out of
 * `peer->rx_ring`. @ref rx_throttled records that RX was disabled because
 * @ref rx_ring was full; the peer's TX path re-enables it once it frees space.
 */
struct bridge_port {
	const struct device *dev;
	struct ring_buf *rx_ring;
	struct bridge_port *peer;
	bool rx_throttled;
};

static struct bridge_port usb_port;
static struct bridge_port esp_port;

static void bridge_isr(const struct device *dev, void *user_data)
{
	struct bridge_port *port = user_data;
	uint8_t buf[BRIDGE_CHUNK];

	while (uart_irq_update(dev) && uart_irq_is_pending(dev)) {
		/* RX: dev FIFO -> our rx_ring, then wake the peer's TX. */
		if (!port->rx_throttled && uart_irq_rx_ready(dev)) {
			size_t space = ring_buf_space_get(port->rx_ring);

			if (space == 0) {
				uart_irq_rx_disable(dev);
				port->rx_throttled = true;
			} else {
				int n = uart_fifo_read(dev, buf, MIN(space, sizeof(buf)));
				int put;

				if (n < 0) {
					n = 0;
				}
				put = ring_buf_put(port->rx_ring, buf, n);
				if (put < n) {
					LOG_WRN("dropped %d bytes", n - put);
				}
				if (put > 0) {
					uart_irq_tx_enable(port->peer->dev);
				}
			}
		}

		/*
		 * TX: drain the peer's rx_ring (bytes destined out of dev).
		 * Claim/finish so only the bytes the FIFO actually accepted are
		 * consumed -- uart_fifo_fill() can take fewer than offered when
		 * the FIFO fills, and dropping the remainder would corrupt large
		 * transfers (e.g. esptool flash blocks).
		 */
		if (uart_irq_tx_ready(dev)) {
			struct ring_buf *src = port->peer->rx_ring;
			uint8_t *out;
			uint32_t claimed = ring_buf_get_claim(src, &out, BRIDGE_CHUNK);

			if (claimed == 0) {
				uart_irq_tx_disable(dev);
			} else {
				int sent = uart_fifo_fill(dev, out, claimed);

				ring_buf_get_finish(src, sent > 0 ? (uint32_t)sent : 0);

				/* Freed ring space -> let the peer's RX resume. */
				if (port->peer->rx_throttled) {
					uart_irq_rx_enable(port->peer->dev);
					port->peer->rx_throttled = false;
				}
			}
		}
	}
}

/** Apply the host's CDC line coding (baud, parity, etc.) to uart1. */
static void apply_host_line_coding(const struct device *cdc)
{
	struct uart_config cfg;
	int err;

	err = uart_config_get(cdc, &cfg);
	if (err) {
		LOG_WRN("Failed to read host line coding (%d)", err);
		return;
	}

	err = uart_configure(esp_dev, &cfg);
	if (err) {
		LOG_WRN("Failed to reconfigure uart1 to %u baud (%d)", cfg.baudrate, err);
	} else {
		LOG_INF("uart1 -> %u baud", cfg.baudrate);
	}
}

static void usbd_msg_cb(struct usbd_context *const ctx, const struct usbd_msg *const msg)
{
	if (usbd_can_detect_vbus(ctx)) {
		if (msg->type == USBD_MSG_VBUS_READY) {
			if (usbd_enable(ctx)) {
				LOG_ERR("Failed to enable device support");
			}
			return;
		}
		if (msg->type == USBD_MSG_VBUS_REMOVED) {
			if (usbd_disable(ctx)) {
				LOG_ERR("Failed to disable device support");
			}
			return;
		}
	}

	if (msg->type == USBD_MSG_CDC_ACM_LINE_CODING) {
		apply_host_line_coding(msg->dev);
	} else if (msg->type == USBD_MSG_CDC_ACM_CONTROL_LINE_STATE) {
		uint32_t rts = 0;

		/*
		 * esptool drives RTS onto the ESP reset line: RTS asserted holds
		 * the chip in reset; releasing it (with GPIO0 grounded) boots the
		 * ROM bootloader. reset-gpios is active-low, so a logical "active"
		 * (1) asserts reset.
		 */
		(void)uart_line_ctrl_get(msg->dev, UART_LINE_CTRL_RTS, &rts);
		(void)gpio_pin_set_dt(&esp_reset, rts ? 1 : 0);
		LOG_DBG("RTS=%u -> ESP reset %s", rts, rts ? "asserted" : "released");
	}
}

int main(void)
{
	struct usbd_context *ctx;

	if (!device_is_ready(cdc_dev)) {
		LOG_ERR("CDC ACM device not ready");
		return 0;
	}
	if (!device_is_ready(esp_dev)) {
		LOG_ERR("uart1 (ESP) device not ready");
		return 0;
	}
	if (!gpio_is_ready_dt(&esp_power) || !gpio_is_ready_dt(&esp_reset)) {
		LOG_ERR("ESP control GPIOs not ready");
		return 0;
	}

	/* Power the ESP and release reset; the host RTS line drives reset from here. */
	(void)gpio_pin_configure_dt(&esp_power, GPIO_OUTPUT_ACTIVE);
	(void)gpio_pin_configure_dt(&esp_reset, GPIO_OUTPUT_INACTIVE);

	usb_port.dev = cdc_dev;
	usb_port.rx_ring = &rb_usb_to_esp;
	usb_port.peer = &esp_port;

	esp_port.dev = esp_dev;
	esp_port.rx_ring = &rb_esp_to_usb;
	esp_port.peer = &usb_port;

	ctx = flasher_usbd_init(usbd_msg_cb);
	if (ctx == NULL) {
		LOG_ERR("Failed to initialize USB device");
		return 0;
	}

	if (!usbd_can_detect_vbus(ctx)) {
		if (usbd_enable(ctx)) {
			LOG_ERR("Failed to enable USB device support");
			return 0;
		}
	}

	uart_irq_callback_user_data_set(cdc_dev, bridge_isr, &usb_port);
	uart_irq_callback_user_data_set(esp_dev, bridge_isr, &esp_port);
	uart_irq_rx_enable(cdc_dev);
	uart_irq_rx_enable(esp_dev);

	LOG_INF("ESP-01 USB <-> uart1 bridge ready");
	return 0;
}
```

## include/usbd_setup.h
```c
/**
 * @file usbd_setup.h
 * @brief Minimal USB device (device_next) context for the CDC ACM bridge.
 *
 * @copyright Copyright (c) 2026 Centro de Inovacao EDGE
 * SPDX-License-Identifier: Apache-2.0
 */

#ifndef ESP01_FLASHER_USBD_SETUP_H
#define ESP01_FLASHER_USBD_SETUP_H

#include <zephyr/usb/usbd.h>

/**
 * @brief Build and initialize the USB device context (CDC ACM class).
 *
 * Registers the string/configuration descriptors and all enabled USB classes,
 * then calls usbd_init(). The caller is responsible for usbd_enable().
 *
 * @param msg_cb USBD message callback (line coding / control line / VBUS), or
 *               NULL to skip registration.
 * @return Pointer to the initialized context, or NULL on failure.
 */
struct usbd_context *flasher_usbd_init(usbd_msg_cb_t msg_cb);

#endif /* ESP01_FLASHER_USBD_SETUP_H */
```

## src/usbd_setup.c
```c
/**
 * @file usbd_setup.c
 * @brief Minimal USB device (device_next) context for the CDC ACM bridge.
 *
 * Distilled from samples/subsys/usb/common/sample_usbd_init.c: a single
 * full-speed configuration exposing the CDC ACM class, with literal VID/PID and
 * string descriptors instead of the sample's Kconfig knobs.
 *
 * @copyright Copyright (c) 2026 Centro de Inovacao EDGE
 * SPDX-License-Identifier: Apache-2.0
 */

#include "usbd_setup.h"

#include <zephyr/device.h>
#include <zephyr/logging/log.h>
#include <zephyr/usb/usbd.h>

LOG_MODULE_REGISTER(usbd_setup, LOG_LEVEL_INF);

/*
 * Zephyr project test VID/PID. Fine for a local bench tool; obtain a real
 * VID/PID before distributing hardware.
 */
#define FLASHER_USBD_VID 0x2fe3
#define FLASHER_USBD_PID 0x0001

/* Bus-powered, no remote wakeup. */
#define FLASHER_USBD_ATTRIBUTES 0
/* Reported max draw, in 2 mA units (250 mA). */
#define FLASHER_USBD_MAX_POWER  125

USBD_DEVICE_DEFINE(flasher_usbd, DEVICE_DT_GET(DT_NODELABEL(usbd)), FLASHER_USBD_VID,
		   FLASHER_USBD_PID);

USBD_DESC_LANG_DEFINE(flasher_lang);
USBD_DESC_MANUFACTURER_DEFINE(flasher_mfr, "Centro de Inovacao EDGE");
USBD_DESC_PRODUCT_DEFINE(flasher_product, "ZBook ESP-01 USB-UART bridge");
IF_ENABLED(CONFIG_HWINFO, (USBD_DESC_SERIAL_NUMBER_DEFINE(flasher_sn)));

USBD_DESC_CONFIG_DEFINE(flasher_fs_cfg_desc, "FS Configuration");

USBD_CONFIGURATION_DEFINE(flasher_fs_config, FLASHER_USBD_ATTRIBUTES, FLASHER_USBD_MAX_POWER,
			  &flasher_fs_cfg_desc);

struct usbd_context *flasher_usbd_init(usbd_msg_cb_t msg_cb)
{
	int err;

	err = usbd_add_descriptor(&flasher_usbd, &flasher_lang);
	if (err) {
		LOG_ERR("Failed to add language descriptor (%d)", err);
		return NULL;
	}

	err = usbd_add_descriptor(&flasher_usbd, &flasher_mfr);
	if (err) {
		LOG_ERR("Failed to add manufacturer descriptor (%d)", err);
		return NULL;
	}

	err = usbd_add_descriptor(&flasher_usbd, &flasher_product);
	if (err) {
		LOG_ERR("Failed to add product descriptor (%d)", err);
		return NULL;
	}

	IF_ENABLED(CONFIG_HWINFO, (err = usbd_add_descriptor(&flasher_usbd, &flasher_sn);))
	if (err) {
		LOG_ERR("Failed to add serial number descriptor (%d)", err);
		return NULL;
	}

	err = usbd_add_configuration(&flasher_usbd, USBD_SPEED_FS, &flasher_fs_config);
	if (err) {
		LOG_ERR("Failed to add Full-Speed configuration (%d)", err);
		return NULL;
	}

	err = usbd_register_all_classes(&flasher_usbd, USBD_SPEED_FS, 1, NULL);
	if (err) {
		LOG_ERR("Failed to register classes (%d)", err);
		return NULL;
	}

	/* CDC ACM owns an Interface Association Descriptor: use the IAD triple. */
	usbd_device_set_code_triple(&flasher_usbd, USBD_SPEED_FS, USB_BCC_MISCELLANEOUS, 0x02,
				    0x01);

	if (msg_cb != NULL) {
		err = usbd_msg_register_cb(&flasher_usbd, msg_cb);
		if (err) {
			LOG_ERR("Failed to register message callback (%d)", err);
			return NULL;
		}
	}

	err = usbd_init(&flasher_usbd);
	if (err) {
		LOG_ERR("Failed to initialize device support (%d)", err);
		return NULL;
	}

	return &flasher_usbd;
}
```
